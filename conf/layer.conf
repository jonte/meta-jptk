## conf/layer.conf
```bitbake
# We have a conf and classes directory, add to BBPATH
BBPATH .= ":${LAYERDIR}"

# We have recipes-* directories, add to BBFILES
BBFILES += "${LAYERDIR}/recipes-*/*/*.bb \
            ${LAYERDIR}/recipes-*/*/*.bbappend"

BBFILE_COLLECTIONS += "meta-jptk"
BBFILE_PATTERN_meta-jptk = "^${LAYERDIR}/"
BBFILE_PRIORITY_meta-jptk = "6"

LAYERDEPENDS_meta-jptk = "core"
LAYERSERIES_COMPAT_meta-jptk = "walnascar"
```

## conf/machine/jptk-t113.conf
```bitbake
#@TYPE: Machine
#@NAME: JPTK T113-S3
#@DESCRIPTION: Machine configuration for the JPTK T113, based on the Allwinner T113-S3 CPU

require conf/machine/include/sun8i.inc

KERNEL_DEVICETREE = "allwinner/jptk-t113.dtb"
KERNEL_IMAGETYPE = "zImage"

UBOOT_MACHINE = "jptk_t113_defconfig"
```

## recipes-bsp/u-boot/files/jptk_t113_defconfig
```kconfig
CONFIG_ARM=y
CONFIG_ARCH_SUNXI=y
CONFIG_DEFAULT_DEVICE_TREE="jptk-t113"
CONFIG_SPL=y
CONFIG_MACH_SUN8I_R528=y
CONFIG_DRAM_CLK=792
CONFIG_DRAM_ZQ=8092667
CONFIG_SUNXI_MINIMUM_DRAM_MB=128
CONFIG_BOOTCOMMAND="bootz 0x40008000 - 0x40A00000"
CONFIG_CMD_SF_TEST=y
CONFIG_MTD=y
CONFIG_DM_MTD=y
CONFIG_MTD_SPI_NAND=y
CONFIG_SPI_FLASH_WINBOND=y
CONFIG_DRAM_SUNXI_ODT_EN=0
CONFIG_DRAM_SUNXI_TPR0=0x004a2195
CONFIG_DRAM_SUNXI_TPR11=0x340000
CONFIG_DRAM_SUNXI_TPR12=0x46
CONFIG_DRAM_SUNXI_TPR13=0x34000100
CONFIG_CONS_INDEX=5
CONFIG_SPI=y
```
